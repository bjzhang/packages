## system/OpenAMP/Kconfig
```kconfig
menu "OpenAMP: AMP solution for rt-thread"

source "$PKGS_DIR/packages/system/OpenAMP/libmetal/Kconfig"
source "$PKGS_DIR/packages/system/OpenAMP/openampnew/Kconfig"

endmenu
```

## system/OpenAMP/libmetal/Kconfig
```kconfig
# Kconfig file for package libmetal
menuconfig PKG_USING_LIBMETAL
    bool "libmetal"
    default n

if PKG_USING_LIBMETAL

    config PKG_LIBMETAL_PATH
        string
        default "/packages/system/OpenAMP/libmetal"

    choice
        prompt "Version"
        default PKG_USING_LIBMETAL_LATEST_VERSION
        help
            Select the package version

        config PKG_USING_LIBMETAL_LATEST_VERSION
            bool "latest"
    endchoice
          
    config PKG_LIBMETAL_VER
       string
       default "latest"    if PKG_USING_LIBMETAL_LATEST_VERSION

endif
```

## system/OpenAMP/openampnew/Kconfig
```kconfig
# Kconfig file for package openamp
menuconfig PKG_USING_OPENAMP
    bool "openampnew"
    default n

if PKG_USING_OPENAMP

    config PKG_OPENAMP_PATH
        string
        default "/packages/system/OpenAMP/openampnew"

    choice
        prompt "Version"
        default PKG_USING_OPENAMP_LATEST_VERSION
        help
            Select the package version

        config PKG_USING_OPENAMP_LATEST_VERSION
            bool "latest"
    endchoice
          
    config PKG_OPENAMP_VER
       string
       default "latest"    if PKG_USING_OPENAMP_LATEST_VERSION

endif
```
